// Sentry Sonar — display node firmware.
//
// A battery-powered e-ink door sign. Every POLL_SECONDS it wakes from deep
// sleep, checks the battery, fetches its room's status from the API
// (GET /rooms/:id, READ token), and redraws ONLY when something changed — then
// goes straight back to deep sleep. E-ink holds the last image with zero power,
// so between wakes the whole board draws ~10 µA.
//
// Per-display identity (room id + READ token) and the WiFi password are injected
// at flash time by flash-display.sh, which writes src/config.gen.h (gitignored).
// See ../README.md → "Flashing a display".
//
// Battery behaviour (e-ink keeps its last frame even when the board dies, so we
// must never leave a stale FREE/OCCUPIED on a dead panel):
//   > 10%  → corner battery graphic shows a rough fill level
//   ≤ 10%  → corner graphic becomes a "!" recharge alert
//   <  3%  → skip the network entirely and show a full-screen RECHARGE ME, so the
//            final persisted image is unambiguous; sleep longer to eke out charge.
//
// Board pin map is FIXED (integrated board, wired internally) — from Waveshare's
// ESP32-S3-ePaper-1.54 demo:
//   EPD:  CS=11  DC=10  SCK=12  MOSI=13  RST=9  BUSY=8   (SSD1681, 200x200 B/W)
//   PWR:  EPD_PWR=6  (ACTIVE-LOW: drive LOW to power the panel)
//   BATT: VBAT_PWR=17 (drive HIGH to enable divider)  ADC=GPIO4 (ADC1_CH3, /2)

#include <Arduino.h>
#include <SPI.h>
#include <WiFi.h>
#include <WiFiClientSecure.h>
#include <HTTPClient.h>
#include <esp_sleep.h>
#include <driver/gpio.h>  // gpio_hold_en/dis — keep VBAT latch high through deep sleep
#include <time.h>
#include <GxEPD2_BW.h>
#include <Fonts/FreeSansBold18pt7b.h>
#include <Fonts/FreeSans9pt7b.h>

#include "logo.h"  // LOGO_BITS / LOGO_W / LOGO_H, generated from the icon PNG

// Per-display config, generated by flash-display.sh (gitignored). Fallbacks keep
// a bare `pio run` compiling without it.
#if __has_include("config.gen.h")
#include "config.gen.h"
#endif
#ifndef DISPLAY_ROOM_ID
#define DISPLAY_ROOM_ID "unset-room"
#endif
#ifndef DISPLAY_TOKEN
#define DISPLAY_TOKEN ""
#endif
#ifndef WIFI_SSID
#define WIFI_SSID "Sentry-Guest"
#endif
#ifndef WIFI_PASS
#define WIFI_PASS ""
#endif
#ifndef API_BASE
#define API_BASE "https://sentry-sonar-api.francesconovy.workers.dev"
#endif

// ---- Board pins (fixed by the integrated board) --------------------------
constexpr int PIN_EPD_CS   = 11;
constexpr int PIN_EPD_DC   = 10;
constexpr int PIN_EPD_SCK  = 12;
constexpr int PIN_EPD_MOSI = 13;
constexpr int PIN_EPD_RST  = 9;
constexpr int PIN_EPD_BUSY = 8;
constexpr int PIN_EPD_PWR  = 6;   // active-LOW panel power gate
constexpr int PIN_VBAT_PWR = 17;  // BATTERY POWER LATCH: HIGH=battery on, LOW=power OFF.
                                  // Assert HIGH at boot, NEVER drive LOW (that shuts the
                                  // board off on battery — it's the demo's power-off cmd).
constexpr int PIN_BAT_ADC  = 4;   // ADC1_CH3, reads Vbat/2

constexpr int SCREEN_W = 200;
constexpr int SCREEN_H = 200;

// ---- Tunables ------------------------------------------------------------
constexpr uint32_t POLL_SECONDS    = 60;    // normal wake cadence (active hours)
constexpr uint32_t CRITICAL_SLEEP  = 300;   // slower polling once critically low
constexpr int      BATT_DEAD_PCT   = 3;     // below this: RECHARGE ME, no network
constexpr int      BATT_ALERT_PCT  = 10;    // below this: "!" on the corner glyph
constexpr uint32_t WIFI_TIMEOUT_MS = 8000;  // per connect attempt
constexpr int      BATT_EMPTY_MV   = 3300;  // LiPo: 3.30V -> 0%
constexpr int      BATT_FULL_MV    = 4200;  // LiPo: 4.20V -> 100%

// ---- Active-hours schedule (office hours only, to save battery) -----------
// Poll only on weekdays between these local hours; outside that, skip Wi-Fi
// entirely and nap until the next active window. Time comes from the API's
// `Date` response header (see fetchScreen), tracked across deep sleep.
constexpr int      ACTIVE_START_HOUR = 8;      // 08:00 local
constexpr int      ACTIVE_END_HOUR   = 18;     // 18:00 local (exclusive)
constexpr bool     SKIP_WEEKENDS     = true;   // no polling Sat/Sun
// Cap on a single off-hours nap. Off-hours wakes are nearly free (no radio), so
// this barely affects battery — it just sets how often we re-check the battery
// and bound clock drift overnight/weekends. The morning resume is always
// scheduled exactly to ACTIVE_START_HOUR regardless of this cap.
constexpr uint32_t NIGHT_CAP_SECONDS = 8 * 3600;  // 8h
// Europe/Vienna, incl. EU DST rule (CET/CEST).
static const char* TZ_VIENNA = "CET-1CEST,M3.5.0,M10.5.0/3";

// ---- Debug mode ----------------------------------------------------------
// 1 = bring-up/debugging: NO deep sleep (board stays awake so USB serial stays
// 1 = debug: identical to production EXCEPT it polls every DEBUG_POLL_SECONDS
//     (instead of POLL_SECONDS), redraws every poll, and stamps the poll time in
//     the top-left corner — so you can watch it tick. Everything else (deep sleep,
//     office-hours schedule, all screens) is the same as production.
// 0 = production.
#define DEBUG_MODE 0
constexpr uint32_t DEBUG_POLL_SECONDS = 20;

#if DEBUG_MODE
#  define DEBUG_TAG "  [DEBUG]"
#else
#  define DEBUG_TAG ""
#endif

// What the panel is currently showing. Used both to pick a layout and as the
// redraw dedup key (together with the battery bucket), so unchanged wakes draw
// nothing at all.
enum Screen : uint8_t {
  SCR_FREE, SCR_OCCUPIED, SCR_UNKNOWN, SCR_NOWIFI, SCR_NOAPI, SCR_RECHARGE,
  SCR_OFFHOURS, SCR_INVALID = 255,
};

// State that must survive deep sleep (RTC memory persists; RAM does not).
RTC_DATA_ATTR uint32_t rtcMagic;       // cold-boot marker
RTC_DATA_ATTR uint8_t  rtcScreen;      // last Screen drawn
RTC_DATA_ATTR int8_t   rtcBattBucket;  // last battery bucket drawn
RTC_DATA_ATTR uint8_t  rtcBssid[6];    // cached AP for fast reconnect
RTC_DATA_ATTR int32_t  rtcChannel;
RTC_DATA_ATTR bool     rtcHaveAp;
RTC_DATA_ATTR bool     rtcTimeValid;   // do we have a wall-clock estimate?
RTC_DATA_ATTR int64_t  rtcEpoch;       // estimated UTC epoch at THIS wake
constexpr uint32_t RTC_MAGIC = 0x50D1A202;  // bump on state/enum changes -> clean re-init

// SSD1681 200x200 B/W panel.
GxEPD2_BW<GxEPD2_154_D67, GxEPD2_154_D67::HEIGHT> display(
    GxEPD2_154_D67(PIN_EPD_CS, PIN_EPD_DC, PIN_EPD_RST, PIN_EPD_BUSY));

static time_t g_epoch = 0;  // last known epoch, for the debug clock stamp

// ---- Battery -------------------------------------------------------------
// VBAT_PWR (GPIO17) is the battery power latch — asserted HIGH once in setup()
// and kept HIGH. It must NOT be toggled here: driving it LOW powers the board
// off on battery (it's the demo's shutdown command). We only read the ADC.
uint32_t readBatteryMv() {
  analogSetPinAttenuation(PIN_BAT_ADC, ADC_11db);  // ~0..3.3V range
  uint32_t acc = 0;
  for (int i = 0; i < 16; i++) acc += analogReadMilliVolts(PIN_BAT_ADC);
  return (acc / 16) * 2;                           // undo the 1/2 divider
}

int batteryPercent(uint32_t mv) {
  long pct = (long)((int)mv - BATT_EMPTY_MV) * 100 / (BATT_FULL_MV - BATT_EMPTY_MV);
  if (pct < 0) pct = 0;
  if (pct > 100) pct = 100;
  return (int)pct;
}

// Coarse level; a redraw is only forced when this changes.
int batteryBucket(int pct) {
  if (pct < BATT_DEAD_PCT)  return 0;   // dead / recharge
  if (pct <= BATT_ALERT_PCT) return 1;  // alert
  if (pct <= 30) return 2;
  if (pct <= 55) return 3;
  if (pct <= 80) return 4;
  return 5;                             // full
}

// ---- Time & schedule -----------------------------------------------------
// Convert a UTC broken-down time to epoch seconds without touching TZ (Howard
// Hinnant's civil-from-days). The system TZ stays Europe/Vienna for local
// decisions, so we can't use mktime() here (it assumes local time).
static long daysFromCivil(int y, unsigned m, unsigned d) {
  y -= m <= 2;
  const long era = (y >= 0 ? y : y - 399) / 400;
  const unsigned yoe = (unsigned)(y - era * 400);
  const unsigned doy = (153 * (m + (m > 2 ? -3 : 9)) + 2) / 5 + d - 1;
  const unsigned doe = yoe * 365 + yoe / 4 - yoe / 100 + doy;
  return era * 146097 + (long)doe - 719468;
}
static time_t utcTmToEpoch(const struct tm& t) {
  long days = daysFromCivil(t.tm_year + 1900, t.tm_mon + 1, t.tm_mday);
  return (time_t)days * 86400 + t.tm_hour * 3600 + t.tm_min * 60 + t.tm_sec;
}

// Is `lt` (local time) inside the active polling window?
static bool isActiveLocal(const struct tm& lt) {
  if (SKIP_WEEKENDS && (lt.tm_wday == 0 || lt.tm_wday == 6)) return false;  // Sun/Sat
  return lt.tm_hour >= ACTIVE_START_HOUR && lt.tm_hour < ACTIVE_END_HOUR;
}

// Epoch of the next active-window start (next weekday at ACTIVE_START_HOUR),
// strictly after `now`. Uses local time + mktime so DST is handled.
static time_t nextActiveStart(time_t now) {
  for (int add = 0; add < 9; add++) {
    struct tm t;
    localtime_r(&now, &t);
    t.tm_mday += add;  // mktime normalizes overflow into the next month
    t.tm_hour = ACTIVE_START_HOUR;
    t.tm_min = 0;
    t.tm_sec = 0;
    t.tm_isdst = -1;
    time_t cand = mktime(&t);
    struct tm c;
    localtime_r(&cand, &c);
    bool weekend = (c.tm_wday == 0 || c.tm_wday == 6);
    if (cand > now && (!SKIP_WEEKENDS || !weekend)) return cand;
  }
  return now + NIGHT_CAP_SECONDS;  // shouldn't happen
}

// ---- WiFi ----------------------------------------------------------------
static void cacheAp() {
  const uint8_t* b = WiFi.BSSID();
  if (b) memcpy(rtcBssid, b, 6);
  rtcChannel = WiFi.channel();
  rtcHaveAp = true;
}

static bool waitForConnect() {
  uint32_t start = millis();
  while (WiFi.status() != WL_CONNECTED && millis() - start < WIFI_TIMEOUT_MS) delay(100);
  return WiFi.status() == WL_CONNECTED;
}

// Connect, preferring the cached BSSID+channel (skips the scan → much less time
// with the radio on). Falls back to a normal connect if the hint is stale.
bool connectWifi() {
  WiFi.persistent(false);
  WiFi.mode(WIFI_STA);
  WiFi.setTxPower(WIFI_POWER_8_5dBm);  // lower TX peak -> gentler on a weak battery
  if (rtcHaveAp) {
    WiFi.begin(WIFI_SSID, WIFI_PASS, rtcChannel, rtcBssid);
    if (waitForConnect()) { cacheAp(); return true; }
    WiFi.disconnect(true);
    delay(50);
  }
  WiFi.begin(WIFI_SSID, WIFI_PASS);
  if (waitForConnect()) { cacheAp(); return true; }
  rtcHaveAp = false;
  return false;
}

// Fetch the room status and map it to a Screen (incl. the failure screens).
// On a successful response, also parses the `Date` header into `epochOut` and
// sets `gotTime` — our free wall-clock source for the active-hours schedule.
Screen fetchScreen(bool& gotTime, time_t& epochOut) {
  if (!connectWifi()) {
    Serial.println("[wifi] connect failed");
    return SCR_NOWIFI;
  }
  Serial.printf("[wifi] connected, ip=%s\n", WiFi.localIP().toString().c_str());

  WiFiClientSecure client;
  client.setInsecure();  // skip cert validation — hackweek LAN use

  HTTPClient http;
  String url = String(API_BASE) + "/rooms/" + DISPLAY_ROOM_ID;
  if (!http.begin(client, url)) return SCR_NOAPI;
  http.addHeader("Authorization", String("Bearer ") + DISPLAY_TOKEN);
  const char* wanted[] = {"Date"};
  http.collectHeaders(wanted, 1);

  int code = http.GET();
  if (code != 200) {
    Serial.printf("[http] GET /rooms/%s -> %d\n", DISPLAY_ROOM_ID, code);
    http.end();
    return SCR_NOAPI;
  }
  // Server time, e.g. "Wed, 21 Oct 2026 07:28:00 GMT" — always UTC.
  String date = http.header("Date");
  struct tm dt = {};
  if (date.length() && strptime(date.c_str(), "%a, %d %b %Y %H:%M:%S", &dt)) {
    epochOut = utcTmToEpoch(dt);
    gotTime = true;
  }
  String body = http.getString();
  http.end();
  Serial.printf("[http] GET /rooms/%s -> 200 %s\n", DISPLAY_ROOM_ID, body.c_str());

  int i = body.indexOf("\"status\":\"");
  if (i < 0) return SCR_NOAPI;
  i += 10;
  int j = body.indexOf('"', i);
  if (j < 0) return SCR_NOAPI;
  String s = body.substring(i, j);
  if (s == "free")    return SCR_FREE;
  if (s == "in_use")  return SCR_OCCUPIED;
  if (s == "offline") return SCR_UNKNOWN;
  return SCR_NOAPI;
}

// ---- Drawing -------------------------------------------------------------
void drawCentered(const char* s, int16_t baselineY, const GFXfont* font) {
  display.setFont(font);
  int16_t bx, by;
  uint16_t bw, bh;
  display.getTextBounds(s, 0, 0, &bx, &by, &bw, &bh);
  display.setCursor((SCREEN_W - (int16_t)bw) / 2 - bx, baselineY);
  display.print(s);
}

void drawCenteredSmall(const char* s, int16_t topY) {
  display.setFont(NULL);  // built-in 5x7
  display.setTextSize(1);
  int16_t bx, by;
  uint16_t bw, bh;
  display.getTextBounds(s, 0, 0, &bx, &by, &bw, &bh);
  display.setCursor((SCREEN_W - (int16_t)bw) / 2 - bx, topY);
  display.print(s);
}

// A battery glyph at (x0,y0) sized w×h. Draws a "!" when pct <= alertPct,
// otherwise a fill proportional to pct. Scales for both the corner and the big
// recharge screen.
void drawBattery(int x0, int y0, int w, int h, int pct, int alertPct) {
  const bool big = w >= 30;
  const int t = big ? 2 : 1;               // outline thickness
  const int nubW = big ? 4 : 2, nubH = h / 2;
  for (int k = 0; k < t; k++)
    display.drawRect(x0 + k, y0 + k, w - 2 * k, h - 2 * k, GxEPD_BLACK);
  display.fillRect(x0 + w, y0 + (h - nubH) / 2, nubW, nubH, GxEPD_BLACK);

  if (pct <= alertPct) {                    // exclamation mark
    const int sw = big ? 6 : 2;             // stroke width
    const int cx = x0 + w / 2 - sw / 2;
    const int top = y0 + h / 5;
    const int stemH = big ? h * 9 / 20 : h - 5;
    const int gap = big ? 4 : 1;
    const int dotH = big ? 5 : 1;
    display.fillRect(cx, top, sw, stemH, GxEPD_BLACK);
    display.fillRect(cx, top + stemH + gap, sw, dotH, GxEPD_BLACK);
  } else {                                  // fill level
    const int inner = w - 2 * t;
    const int fill = inner * pct / 100;
    if (fill > 0) display.fillRect(x0 + t, y0 + t, fill, h - 2 * t, GxEPD_BLACK);
  }
}

static const char* headlineFor(Screen s) {
  switch (s) {
    case SCR_FREE:     return "FREE";
    case SCR_OCCUPIED: return "OCCUPIED";
    case SCR_UNKNOWN:  return "UNKNOWN";
    case SCR_NOWIFI:
    case SCR_NOAPI:    return "OFFLINE";
    case SCR_OFFHOURS: return "OFF HOURS";
    default:           return "";
  }
}

static const char* subtitleFor(Screen s) {
  switch (s) {
    case SCR_UNKNOWN:  return "sensor offline";
    case SCR_NOWIFI:   return "no Wi-Fi";
    case SCR_NOAPI:    return "no signal";
    case SCR_OFFHOURS: return "monitoring paused";
    default:           return nullptr;
  }
}

static const char* screenName(Screen s) {
  switch (s) {
    case SCR_FREE:     return "FREE";
    case SCR_OCCUPIED: return "OCCUPIED";
    case SCR_UNKNOWN:  return "UNKNOWN";
    case SCR_NOWIFI:   return "NOWIFI";
    case SCR_NOAPI:    return "NOAPI";
    case SCR_RECHARGE: return "RECHARGE";
    case SCR_OFFHOURS: return "OFFHOURS";
    default:           return "INVALID";
  }
}

void powerPanel(bool on) {
  pinMode(PIN_EPD_PWR, OUTPUT);
  digitalWrite(PIN_EPD_PWR, on ? LOW : HIGH);  // active-LOW
}

void render(Screen scr, int pct) {
  powerPanel(true);
  delay(100);
  SPI.begin(PIN_EPD_SCK, /*MISO=*/-1, PIN_EPD_MOSI, PIN_EPD_CS);
  display.init(115200);
  display.setRotation(0);
  display.setTextColor(GxEPD_BLACK);
  display.setFullWindow();
  display.firstPage();
  do {
    display.fillScreen(GxEPD_WHITE);
#if DEBUG_MODE
    {  // debug: stamp the poll time top-left so you can watch it tick each poll
      struct tm lt;
      localtime_r(&g_epoch, &lt);
      char t[16];
      strftime(t, sizeof(t), "%H:%M:%S", &lt);
      display.setFont(NULL);
      display.setTextSize(1);
      display.setCursor(2, 2);
      display.print(t);
    }
#endif
    if (scr == SCR_RECHARGE) {
      // Dedicated dying-battery screen — no room status at all.
      drawBattery(/*x0=*/(SCREEN_W - 76 - 4) / 2, /*y0=*/26, /*w=*/76, /*h=*/36,
                  /*pct=*/0, /*alertPct=*/100);
      drawCentered("RECHARGE", 118, &FreeSansBold18pt7b);
      drawCentered("ME", 158, &FreeSansBold18pt7b);
      drawCenteredSmall("plug in to charge", 178);
    } else {
      const int logoX = (SCREEN_W - LOGO_W) / 2, logoY = 12;
      display.drawBitmap(logoX, logoY, LOGO_BITS, LOGO_W, LOGO_H, GxEPD_BLACK);
      drawCentered("SENTRY SONAR", logoY + LOGO_H + 20, &FreeSans9pt7b);
      drawCentered(headlineFor(scr), 178, &FreeSansBold18pt7b);
      const char* sub = subtitleFor(scr);
      if (sub) drawCenteredSmall(sub, 186);
      drawBattery(/*x0=*/SCREEN_W - 3 - 2 - 14, /*y0=*/4, /*w=*/14, /*h=*/8,
                  pct, BATT_ALERT_PCT);
    }
  } while (display.nextPage());
  display.hibernate();
  powerPanel(false);  // cut the panel rail; e-ink keeps the image
}

// ---- Lifecycle -----------------------------------------------------------
void deepSleep(uint32_t seconds) {
  WiFi.disconnect(true);
  WiFi.mode(WIFI_OFF);
  Serial.printf("deep sleep %us\n", seconds);
  Serial.flush();
  // Latch the battery-power pin (GPIO17) HIGH through deep sleep — otherwise the
  // ESP32 floats its GPIOs while sleeping, the VBAT latch opens, and the board
  // powers off on battery and never wakes.
  gpio_hold_en((gpio_num_t)PIN_VBAT_PWR);
  gpio_deep_sleep_hold_en();
  esp_sleep_enable_timer_wakeup((uint64_t)seconds * 1000000ULL);
  esp_deep_sleep_start();
}

// One poll/draw cycle. Returns how many seconds to wait before the next one.
uint32_t runCycle(bool cold) {
  uint32_t mv = readBatteryMv();
  int pct = batteryPercent(mv);
  int bucket = batteryBucket(pct);
  Serial.printf("battery: %u mV (~%d%%) bucket=%d\n", mv, pct, bucket);

  // 1) Critical battery overrides everything: no radio, show RECHARGE.
  if (pct < BATT_DEAD_PCT) {
    Serial.println("battery critical — skipping network");
    if (cold || rtcScreen != SCR_RECHARGE) {
      render(SCR_RECHARGE, pct);
      rtcScreen = SCR_RECHARGE;
      rtcBattBucket = (int8_t)bucket;
    }
    return CRITICAL_SLEEP;
  }

  // 2) Are we inside active hours? Needs a clock estimate; if we have none yet
  //    (cold boot), we poll anyway to acquire the time from the Date header.
  bool haveTime = rtcTimeValid;
  time_t nowEpoch = haveTime ? (time_t)rtcEpoch : 0;
  bool activeNow = true;
  if (haveTime) {
    struct tm lt;
    localtime_r(&nowEpoch, &lt);
    char b[32];
    strftime(b, sizeof(b), "%a %H:%M", &lt);
    activeNow = isActiveLocal(lt);
    Serial.printf("local: %s  active=%d\n", b, activeNow);
  } else {
    Serial.println("no clock yet — polling to acquire time");
  }

  // 3) Poll when active (or still time-less); else show OFF HOURS, radio off.
  Screen desired;
  if (activeNow || !haveTime) {
    bool gotTime = false;
    time_t netEpoch = 0;
    desired = fetchScreen(gotTime, netEpoch);
    if (gotTime) {
      nowEpoch = netEpoch;
      haveTime = true;
      rtcTimeValid = true;
      // Polled only to learn the time; if it's off-hours, show OFF HOURS.
      struct tm lt;
      localtime_r(&nowEpoch, &lt);
      if (!isActiveLocal(lt)) desired = SCR_OFFHOURS;
    }
  } else {
    desired = SCR_OFFHOURS;
  }
  Serial.printf("screen=%s\n", screenName(desired));

  // Network is done — power the radio down BEFORE the e-ink refresh so the Wi-Fi
  // and panel current spikes don't overlap and brown out a battery-powered board.
  WiFi.disconnect(true);
  WiFi.mode(WIFI_OFF);
  delay(50);  // let the rail settle after the radio drops

  g_epoch = nowEpoch;  // for the debug clock stamp

  // 4) Redraw when the frame changed (or always, in debug).
  bool forceDraw = false;
#if DEBUG_MODE
  forceDraw = true;
#endif
  if (cold || forceDraw || desired != rtcScreen || bucket != rtcBattBucket) {
    Serial.println("draw");
    render(desired, pct);
    rtcScreen = desired;
    rtcBattBucket = (int8_t)bucket;
  } else {
    Serial.println("skip (no redraw)");
  }

  // 5) How long until the next poll: the active-hours interval, else nap until
  //    the next active window (capped so battery is still checked periodically).
#if DEBUG_MODE
  const uint32_t pollInterval = DEBUG_POLL_SECONDS;
#else
  const uint32_t pollInterval = POLL_SECONDS;
#endif
  uint32_t sleepS = pollInterval;
  if (haveTime) {
    struct tm lt;
    localtime_r(&nowEpoch, &lt);
    if (!isActiveLocal(lt)) {
      time_t wake = nextActiveStart(nowEpoch);
      long secs = (long)(wake - nowEpoch);
      if (secs < (long)pollInterval) secs = pollInterval;
      sleepS = (uint32_t)(secs < (long)NIGHT_CAP_SECONDS ? secs : NIGHT_CAP_SECONDS);
      struct tm wl;
      localtime_r(&wake, &wl);
      char b[32];
      strftime(b, sizeof(b), "%a %H:%M", &wl);
      Serial.printf("off-hours — next active %s (nap %us)\n", b, sleepS);
    }
  }

  // Pre-advance the clock estimate to the next wake (re-anchored on next poll).
  if (haveTime) rtcEpoch = (int64_t)nowEpoch + (millis() / 1000) + sleepS;
  return sleepS;
}

void setup() {
  // FIRST THING: latch battery power on (GPIO17 HIGH). On this board VBAT_PWR
  // gates the battery to the whole system, so assert it immediately — otherwise
  // the board can't run on battery / dies the instant USB is unplugged. It is
  // never driven LOW anywhere (LOW = power off).
  pinMode(PIN_VBAT_PWR, OUTPUT);
  digitalWrite(PIN_VBAT_PWR, HIGH);
  gpio_hold_dis((gpio_num_t)PIN_VBAT_PWR);  // release the deep-sleep hold (no-op on cold
                                            // boot); the driven HIGH above carries over
                                            // seamlessly, so the latch never drops

  setCpuFrequencyMhz(80);  // enough for WiFi, less power than 240
  Serial.begin(115200);
  delay(50);
  setenv("TZ", TZ_VIENNA, 1);  // so localtime_r/mktime give DST-correct local time
  tzset();

  bool cold = (rtcMagic != RTC_MAGIC);
  if (cold) {
    rtcMagic = RTC_MAGIC;
    rtcScreen = SCR_INVALID;
    rtcBattBucket = -1;
    rtcHaveAp = false;
    rtcTimeValid = false;
  }
  Serial.printf("\n=== Sentry Sonar :: display-node === room=%s %s%s\n",
                DISPLAY_ROOM_ID, cold ? "(cold boot)" : "(wake)", DEBUG_TAG);
  if (strlen(DISPLAY_TOKEN) == 0)
    Serial.println("[warn] no token — reflash with flash-display.sh");

  deepSleep(runCycle(cold));  // one cycle, then deep sleep (which restarts setup)
}

void loop() {
  // Unused — setup() always ends in deep sleep, which restarts at setup().
}
